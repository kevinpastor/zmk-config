## config/west.yml
```yaml
manifest:
  remotes:
    - url-base: https://github.com/zmkfirmware
      name: zmkfirmware
    - url-base: https://github.com/urob
      name: urob
    - url-base: https://github.com/kevinpastor
      name: kevinpastor
  projects:
    - remote: zmkfirmware
      name: zmk
      revision: main
      import: app/west.yml
    - remote: urob
      name: zmk-helpers
      revision: main
    - remote: kevinpastor
      name: nice-view-elemental
      revision: update-to-zmk-0.4
  self:
    path: config
```
