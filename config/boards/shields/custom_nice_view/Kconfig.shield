## config/boards/shields/custom_nice_view/Kconfig.shield
```kconfig
# Copyright (c) 2022 The ZMK Contributors
# SPDX-License-Identifier: MIT

config SHIELD_CUSTOM_NICE_VIEW
    def_bool $(shields_list_contains,custom_nice_view)
```

## config/boards/shields/nice_view_elemental/Kconfig.shield
```kconfig
config SHIELD_NICE_VIEW_ELEMENTAL
    def_bool $(shields_list_contains,nice_view_elemental)
```
